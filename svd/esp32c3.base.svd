# ESP32C3 register map
File version: 1.0
CPU: RISC-V RV32IMC single-core 1, little endian, no MPU, FPU, 3 interrupt priority bits
Registers are 32-bit, read-write, reset 0x0 unless marked. A register's access mark holds for its fields unless they carry their own. Offsets are from the block's base; [hi:lo] are bit positions; {n}, {i} and the like mark numbered series.

## INTERRUPT_CORE0
Base 0x00000000
0x00 INTERRUPT_CORE0_MAC_INTR_MAP
  [4:0] INTERRUPT_CORE0_MAC_INTR_MAP
0x04 INTERRUPT_CORE0_MAC_NMI_MAP
  [4:0] INTERRUPT_CORE0_MAC_NMI_MAP
0x08 INTERRUPT_CORE0_PWR_INTR_MAP
  [4:0] INTERRUPT_CORE0_PWR_INTR_MAP
0x0C INTERRUPT_CORE0_BB_INT_MAP
  [4:0] INTERRUPT_CORE0_BB_INT_MAP
0x10 INTERRUPT_CORE0_BT_MAC_INT_MAP
  [4:0] INTERRUPT_CORE0_BT_MAC_INT_MAP
0x14 INTERRUPT_CORE0_BT_BB_INT_MAP
  [4:0] INTERRUPT_CORE0_BT_BB_INT_MAP
0x18 INTERRUPT_CORE0_BT_BB_NMI_MAP
  [4:0] INTERRUPT_CORE0_BT_BB_NMI_MAP
0x1C INTERRUPT_CORE0_RWBT_IRQ_MAP
  [4:0] INTERRUPT_CORE0_RWBT_IRQ_MAP
0x20 INTERRUPT_CORE0_RWBLE_IRQ_MAP
  [4:0] INTERRUPT_CORE0_RWBLE_IRQ_MAP
0x24 INTERRUPT_CORE0_RWBT_NMI_MAP
  [4:0] INTERRUPT_CORE0_RWBT_NMI_MAP
0x28 INTERRUPT_CORE0_RWBLE_NMI_MAP
  [4:0] INTERRUPT_CORE0_RWBLE_NMI_MAP
0x2C INTERRUPT_CORE0_I2C_MST_INT_MAP
  [4:0] INTERRUPT_CORE0_I2C_MST_INT_MAP
0x30 INTERRUPT_CORE0_SLC0_INTR_MAP
  [4:0] INTERRUPT_CORE0_SLC0_INTR_MAP
0x34 INTERRUPT_CORE0_SLC1_INTR_MAP
  [4:0] INTERRUPT_CORE0_SLC1_INTR_MAP
0x38 INTERRUPT_CORE0_APB_CTRL_INTR_MAP
  [4:0] INTERRUPT_CORE0_APB_CTRL_INTR_MAP
0x3C INTERRUPT_CORE0_UHCI0_INTR_MAP
  [4:0] INTERRUPT_CORE0_UHCI0_INTR_MAP
0x40 INTERRUPT_CORE0_GPIO_INTERRUPT_PRO_MAP
  [4:0] INTERRUPT_CORE0_GPIO_INTERRUPT_PRO_MAP
0x44 INTERRUPT_CORE0_GPIO_INTERRUPT_PRO_NMI_MAP
  [4:0] INTERRUPT_CORE0_GPIO_INTERRUPT_PRO_NMI_MAP
0x48 INTERRUPT_CORE0_SPI_INTR_1_MAP
  [4:0] INTERRUPT_CORE0_SPI_INTR_1_MAP
0x4C INTERRUPT_CORE0_SPI_INTR_2_MAP
  [4:0] INTERRUPT_CORE0_SPI_INTR_2_MAP
0x50 INTERRUPT_CORE0_I2S1_INT_MAP
  [4:0] INTERRUPT_CORE0_I2S1_INT_MAP
0x54 INTERRUPT_CORE0_UART_INTR_MAP
  [4:0] INTERRUPT_CORE0_UART_INTR_MAP
0x58 INTERRUPT_CORE0_UART1_INTR_MAP
  [4:0] INTERRUPT_CORE0_UART1_INTR_MAP
0x5C INTERRUPT_CORE0_LEDC_INT_MAP
  [4:0] INTERRUPT_CORE0_LEDC_INT_MAP
0x60 INTERRUPT_CORE0_EFUSE_INT_MAP
  [4:0] INTERRUPT_CORE0_EFUSE_INT_MAP
0x64 INTERRUPT_CORE0_CAN_INT_MAP
  [4:0] INTERRUPT_CORE0_CAN_INT_MAP
0x68 INTERRUPT_CORE0_USB_INTR_MAP
  [4:0] INTERRUPT_CORE0_USB_INTR_MAP
0x6C INTERRUPT_CORE0_RTC_CORE_INTR_MAP
  [4:0] INTERRUPT_CORE0_RTC_CORE_INTR_MAP
0x70 INTERRUPT_CORE0_RMT_INTR_MAP
  [4:0] INTERRUPT_CORE0_RMT_INTR_MAP
0x74 INTERRUPT_CORE0_I2C_EXT0_INTR_MAP
  [4:0] INTERRUPT_CORE0_I2C_EXT0_INTR_MAP
0x78 INTERRUPT_CORE0_TIMER_INT1_MAP
  [4:0] INTERRUPT_CORE0_TIMER_INT1_MAP
0x7C INTERRUPT_CORE0_TIMER_INT2_MAP
  [4:0] INTERRUPT_CORE0_TIMER_INT2_MAP
0x80 INTERRUPT_CORE0_TG_T0_INT_MAP
  [4:0] INTERRUPT_CORE0_TG_T0_INT_MAP
0x84 INTERRUPT_CORE0_TG_WDT_INT_MAP
  [4:0] INTERRUPT_CORE0_TG_WDT_INT_MAP
0x88 INTERRUPT_CORE0_TG1_T0_INT_MAP
  [4:0] INTERRUPT_CORE0_TG1_T0_INT_MAP
0x8C INTERRUPT_CORE0_TG1_WDT_INT_MAP
  [4:0] INTERRUPT_CORE0_TG1_WDT_INT_MAP
0x90 INTERRUPT_CORE0_CACHE_IA_INT_MAP
  [4:0] INTERRUPT_CORE0_CACHE_IA_INT_MAP
{0x94+4i} INTERRUPT_CORE0_SYSTIMER_TARGET{i}_INT_MAP (i=0..2)
  [4:0] INTERRUPT_CORE0_SYSTIMER_TARGET{i}_INT_MAP
0xA0 INTERRUPT_CORE0_SPI_MEM_REJECT_INTR_MAP
  [4:0] INTERRUPT_CORE0_SPI_MEM_REJECT_INTR_MAP
0xA4 INTERRUPT_CORE0_ICACHE_PRELOAD_INT_MAP
  [4:0] INTERRUPT_CORE0_ICACHE_PRELOAD_INT_MAP
0xA8 INTERRUPT_CORE0_ICACHE_SYNC_INT_MAP
  [4:0] INTERRUPT_CORE0_ICACHE_SYNC_INT_MAP
0xAC INTERRUPT_CORE0_APB_ADC_INT_MAP
  [4:0] INTERRUPT_CORE0_APB_ADC_INT_MAP
{0xB0+4i} INTERRUPT_CORE0_DMA_CH{i}_INT_MAP (i=0..2)
  [4:0] INTERRUPT_CORE0_DMA_CH{i}_INT_MAP
0xBC INTERRUPT_CORE0_RSA_INT_MAP
  [4:0] INTERRUPT_CORE0_RSA_INT_MAP
0xC0 INTERRUPT_CORE0_AES_INT_MAP
  [4:0] INTERRUPT_CORE0_AES_INT_MAP
0xC4 INTERRUPT_CORE0_SHA_INT_MAP
  [4:0] INTERRUPT_CORE0_SHA_INT_MAP
{0xC8+4i} INTERRUPT_CORE0_CPU_INTR_FROM_CPU_{i}_MAP (i=0..3)
  [4:0] INTERRUPT_CORE0_CPU_INTR_FROM_CPU_{i}_MAP
0xD8 INTERRUPT_CORE0_ASSIST_DEBUG_INTR_MAP
  [4:0] INTERRUPT_CORE0_ASSIST_DEBUG_INTR_MAP
0xDC INTERRUPT_CORE0_DMA_APBPERI_PMS_MONITOR_VIOLATE_INTR_MAP
  [4:0] INTERRUPT_CORE0_DMA_APBPERI_PMS_MONITOR_VIOLATE_INTR_MAP
0xE0 INTERRUPT_CORE0_CORE_0_IRAM0_PMS_MONITOR_VIOLATE_INTR_MAP
  [4:0] INTERRUPT_CORE0_CORE_0_IRAM0_PMS_MONITOR_VIOLATE_INTR_MAP
0xE4 INTERRUPT_CORE0_CORE_0_DRAM0_PMS_MONITOR_VIOLATE_INTR_MAP
  [4:0] INTERRUPT_CORE0_CORE_0_DRAM0_PMS_MONITOR_VIOLATE_INTR_MAP
0xE8 INTERRUPT_CORE0_CORE_0_PIF_PMS_MONITOR_VIOLATE_INTR_MAP
  [4:0] INTERRUPT_CORE0_CORE_0_PIF_PMS_MONITOR_VIOLATE_INTR_MAP
0xEC INTERRUPT_CORE0_CORE_0_PIF_PMS_MONITOR_VIOLATE_SIZE_INTR_MAP
  [4:0] INTERRUPT_CORE0_CORE_0_PIF_PMS_MONITOR_VIOLATE_SIZE_INTR_MAP
0xF0 INTERRUPT_CORE0_BACKUP_PMS_VIOLATE_INTR_MAP
  [4:0] INTERRUPT_CORE0_BACKUP_PMS_VIOLATE_INTR_MAP
0xF4 INTERRUPT_CORE0_CACHE_CORE0_ACS_INT_MAP
  [4:0] INTERRUPT_CORE0_CACHE_CORE0_ACS_INT_MAP
0xF8 INTERRUPT_CORE0_INTR_STATUS_0 ro
0xFC INTERRUPT_CORE0_INTR_STATUS_1 ro
0x100 INTERRUPT_CORE0_CLOCK_GATE
  [0] INTERRUPT_CORE0_CLK_EN
0x104 INTERRUPT_CORE0_CPU_INT_ENABLE
0x108 INTERRUPT_CORE0_CPU_INT_TYPE
0x10C INTERRUPT_CORE0_CPU_INT_CLEAR
0x110 INTERRUPT_CORE0_CPU_INT_EIP_STATUS ro
{0x114+4i} INTERRUPT_CORE0_CPU_INT_PRI_{i} (i=0..31)
  [3:0] INTERRUPT_CORE0_CPU_PRI_{i}_MAP
0x194 INTERRUPT_CORE0_CPU_INT_THRESH
  [3:0] INTERRUPT_CORE0_CPU_INT_THRESH
0x7FC INTERRUPT_CORE0_INTERRUPT_DATE
  [27:0] INTERRUPT_CORE0_INTERRUPT_DATE
